## conf/machine/pulse4k.conf
```bitbake
#@TYPE: Machine
#@NAME: ABCom  Pulse4k
#@DESCRIPTION: Machine configuration for the Pulse4k

MACHINE_FEATURES += " 7segment textlcd blindscan hisil mali transcoding dvb-c emmc wol"
OPENPLI_FEATURES += " qtplugins kodi openhbbtvbrowser"
DISTRO_FEATURES_remove = "x11 wayland directfb"

TARGET_ARCH = "arm"
DEFAULTTUNE = "cortexa15hf-neon-vfpv4"

IMAGE_CLASSES += " abcom_image"
IMAGE_FSTYPES += " abcomimage"

CMDLINE ?= "console=ttyAMA0,115200n8"

CHIPSET = "Hi3798Mv200"
RCTYPE = "30"

require conf/machine/include/abcom-mv200.inc
```
